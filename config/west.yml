## config/west.yml
```yaml
manifest:
  remotes:
    - name: zmkfirmware
      url-base: https://github.com/zmkfirmware
    - name: badjeff
      url-base: https://github.com/badjeff
    - name: s-katada  # <-- PMW3610ドライバのfork（暴走バグ修正）
      url-base: https://github.com/s-katada
    - name: hsgw
      url-base: https://github.com/hsgw
    - name: caksoylar  # <-- led
      url-base: https://github.com/caksoylar  

  projects:
    # ZMK 本体。公式の app/west.yml を取り込む
    - name: zmk
      remote: zmkfirmware
      revision: v0.3
      import: app/west.yml

    # PMW3610 ドライバ（外部モジュール）
    # kobu の実機検証済み設計に合わせた fork に固定。badjeff zmk-0.3 へ:
    #  - never-downshift（force-awakeを常時維持＝RESTさせない）で無操作後の暴走を根治
    #  - buf[0]==0xFF ガベージガード（MOTビットガードは撤去：force-awakeでは遅い動きを誤って捨てるため）
    #  - CONFIG_PMW3610_MAX_DELTA（部分SPIグリッチの「ギュン」抑止。スクロール側のみ有効）
    # を追加（commit c241b53 / branch zmk-0.3-fix-runaway）。
    # 上流に戻す場合: remote=badjeff, revision=zmk-0.3 へ戻すだけ。
    - name: zmk-pmw3610-driver
      remote: s-katada
      revision: c241b533f2951c28279b421f398b4550ecdf3153
    
    # Sensor-rotation
    - name: zmk-feature-sensor_rotation
      remote: hsgw
      revision: main

    # LED
    # revision を固定。caksoylar main は 2026-02-17 に v0.3 互換 shim を削除
    # （"Remove v0.3 compatibility shims from adapter"）し、ZMK v0.3 では
    # rgbled_adapter の赤色LEDエイリアスが解決できずビルドが失敗する。
    # a3510c9d は最後にグリーンビルドした時点の既知良好版（v0.3互換 shim あり）。
    - name: zmk-rgbled-widget  # <-- led
      remote: caksoylar
      revision: a3510c9de46de8b42c803286f4978466c6ea3916
      
  self:
    path: config
```
